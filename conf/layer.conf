## conf/layer.conf
```bitbake
# We have a conf and classes directory, add to BBPATH
BBPATH .= ":${LAYERDIR}"

# We have recipes-* directories, add to BBFILES
BBFILES += "${LAYERDIR}/recipes-*/*/*.bb \
            ${LAYERDIR}/recipes-*/*/*.bbappend \
"

BBFILE_COLLECTIONS += "meta-station"
BBFILE_PATTERN_meta-station = "^${LAYERDIR}/"
BBFILE_PRIORITY_meta-station = "6"

LAYERDEPENDS_meta-station = "core"
LAYERSERIES_COMPAT_meta-station = "scarthgap"
```
